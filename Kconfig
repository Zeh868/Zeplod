## src/modules/connectivity/Kconfig
```kconfig
menuconfig CONNECTIVITY_MODULE
	bool "Enable connectivity module"
	default n
	depends on EVENT_MAX_TYPES > 60
	help
	  Link up/down abstraction with a priority-ordered backend registry and
	  runtime failover. Requires CONFIG_EVENT_MAX_TYPES > 60 (event ID 60).

if CONNECTIVITY_MODULE

config CONNECTIVITY_MODULE_AUTOINIT
	bool "Auto-register connectivity module at boot"
	default y

comment "Backends (independently selectable; priority decides connect_auto()/failover order)"

config CONNECTIVITY_BACKEND_NULL
	bool "Null (sync stub) backend"
	default y
	help
	  Synchronously simulates link up/down; used by ztest / native_sim and
	  as a safe default when no real transport is configured. Also acts as
	  a wildcard for connectivity_module_connect(): if no registered backend
	  matches the requested link_type, the null backend (when present) is
	  used instead so existing single-backend callers keep working.

config CONNECTIVITY_BACKEND_NULL_PRIORITY
	int "Null backend priority"
	default 10
	range 0 100
	depends on CONNECTIVITY_BACKEND_NULL
	help
	  Higher value = tried first by connect_auto()/failover. Null is kept
	  lowest by default so it never preempts a real transport.

config CONNECTIVITY_BACKEND_WIFI
	bool "Wi-Fi backend (net_mgmt/wifi_mgmt)"
	depends on WIFI && NET_L2_WIFI_MGMT && PROVISIONING_MODULE
	select NET_MGMT_EVENT_INFO
	help
	  Real Wi-Fi link via Zephyr's net_mgmt/wifi_mgmt subsystem. SSID/PSK are
	  read from the provisioning module (persisted via app_kv/NVS); connect()
	  waits (bounded, see CONNECTIVITY_BACKEND_WIFI_CONNECT_TIMEOUT_MS) for the
	  NET_EVENT_WIFI_CONNECT_RESULT callback before returning, so the existing
	  connectivity_module synchronous is_link_up() check after connect() still
	  reflects the real outcome.

config CONNECTIVITY_BACKEND_WIFI_PRIORITY
	int "Wi-Fi backend priority"
	default 30
	range 0 100
	depends on CONNECTIVITY_BACKEND_WIFI

if CONNECTIVITY_BACKEND_WIFI

config CONNECTIVITY_BACKEND_WIFI_CONNECT_TIMEOUT_MS
	int "Wi-Fi connect bounded wait timeout (ms)"
	default 15000
	range 1000 60000
	help
	  Upper bound for connect() to wait for the net_mgmt connect-result
	  callback before giving up and returning -ETIMEDOUT.

endif # CONNECTIVITY_BACKEND_WIFI

config CONNECTIVITY_BACKEND_ETHERNET
	bool "Ethernet backend (net_mgmt/net_if)"
	depends on NET_L2_ETHERNET
	help
	  Real Ethernet link via Zephyr's net_mgmt: listens for
	  NET_EVENT_IF_UP/DOWN and NET_EVENT_IPV4_ADDR_ADD to track link state;
	  connect() brings the interface up and waits (bounded) for a DHCP-bound
	  IPv4 address before returning.

config CONNECTIVITY_BACKEND_ETHERNET_PRIORITY
	int "Ethernet backend priority"
	default 40
	range 0 100
	depends on CONNECTIVITY_BACKEND_ETHERNET
	help
	  Ethernet defaults to the highest priority: wired links are generally
	  the most stable/preferred transport when available.

if CONNECTIVITY_BACKEND_ETHERNET

config CONNECTIVITY_BACKEND_ETHERNET_CONNECT_TIMEOUT_MS
	int "Ethernet connect bounded wait timeout (ms)"
	default 15000
	range 1000 60000
	help
	  Upper bound for connect() to wait for a DHCP-bound IPv4 address
	  (NET_EVENT_IPV4_ADDR_ADD) before giving up and returning -ETIMEDOUT.

endif # CONNECTIVITY_BACKEND_ETHERNET

config CONNECTIVITY_BACKEND_CELLULAR
	bool "Cellular backend (Zephyr generic modem_cellular / PPP)"
	depends on MODEM_CELLULAR
	select NET_L2_PPP
	select NET_CONNECTION_MANAGER
	help
	  Drives the PPP network interface exposed by Zephyr's generic
	  CONFIG_MODEM_CELLULAR driver, which already supports common modules
	  (Quectel BG9x/EG25-G, SIMCom SIM7080/A76xx, u-blox SARA-R4/R5 &
	  LARA-R6, Telit, Sierra HL78xx, ...). This backend is model-agnostic:
	  connect() brings the PPP iface up (optionally resuming the modem via
	  PM_DEVICE) and waits (bounded, see
	  CONNECTIVITY_BACKEND_CELLULAR_CONNECT_TIMEOUT_MS) for the conn_mgr
	  NET_EVENT_L4_CONNECTED event; disconnect() brings it down.

	  Selecting a specific model = binding the matching modem_cellular
	  compatible node in the devicetree (typically over a UART, with an
	  aliases { modem = &... }; entry) and configuring the APN via the
	  driver's CONFIG_MODEM_CELLULAR_APN. NET_L2_PPP and NET_CONNECTION_MANAGER
	  are selected so the PPP iface and L4 events this backend relies on are
	  always present. No cellular hardware is available in this repository, so
	  end-to-end operation is untested here (build-only).

config CONNECTIVITY_BACKEND_CELLULAR_PRIORITY
	int "Cellular backend priority"
	default 20
	range 0 100
	depends on CONNECTIVITY_BACKEND_CELLULAR
	help
	  Cellular defaults below Wi-Fi (typically metered/higher-latency) but
	  above null.

if CONNECTIVITY_BACKEND_CELLULAR

config CONNECTIVITY_BACKEND_CELLULAR_CONNECT_TIMEOUT_MS
	int "Cellular connect bounded wait timeout (ms)"
	default 30000
	range 1000 120000
	help
	  Upper bound for connect() to wait for the NET_EVENT_L4_CONNECTED
	  callback before giving up and returning -ETIMEDOUT. Higher than the
	  Wi-Fi/Ethernet defaults since modem registration/PPP negotiation is
	  typically slower.

endif # CONNECTIVITY_BACKEND_CELLULAR

comment "Failover manager (only meaningful with 2+ backends enabled above)"

config CONNECTIVITY_FAILOVER
	bool "Enable runtime failover manager"
	default y
	help
	  When 2 or more backends are registered, periodically polls the active
	  backend's link state and re-runs connect_auto() if it drops. With a
	  single backend registered this is a harmless no-op poller (e.g. the
	  default null-only build).

config CONNECTIVITY_FAILOVER_PREEMPT
	bool "Preempt to a higher-priority backend when it becomes available"
	default y
	depends on CONNECTIVITY_FAILOVER
	help
	  If a backend with higher priority than the currently active one
	  becomes available again, connect it and confirm it is up before
	  tearing down the lower-priority link (make-before-break), instead of
	  staying on the lower-priority backend indefinitely.

config CONNECTIVITY_FAILOVER_POLL_MS
	int "Failover health poll period (ms)"
	default 5000
	range 500 60000
	depends on CONNECTIVITY_FAILOVER
	help
	  Period of the k_work_delayable health/preempt poll.

config CONNECTIVITY_FAILOVER_WORKQ_STACK_SIZE
	int "Failover dedicated workqueue thread stack size (bytes)"
	default 2048
	range 1024 8192
	depends on CONNECTIVITY_FAILOVER
	help
	  Stack size of the dedicated workqueue thread that runs the failover
	  poll/preempt work. The failover handler calls backend connect()/
	  disconnect(), which may walk the net_mgmt / DHCP / modem code paths and
	  therefore need a non-trivial stack. Increase this if the failover thread
	  overflows its stack (e.g. observed via CONFIG_THREAD_STACK_INFO /
	  a stack sentinel fault). Kept on a private queue (not the system
	  workqueue) so a slow/blocking connect() cannot stall system work such as
	  network timers.

config CONNECTIVITY_FAILOVER_THREAD_PRIORITY
	int "Failover dedicated workqueue thread priority"
	default 5
	range 0 15
	depends on CONNECTIVITY_FAILOVER
	help
	  Scheduling priority of the dedicated failover workqueue thread
	  (lower value = higher priority; positive values are preemptible).
	  Defaults to 5 to match the event dispatcher / data bus background
	  threads. Since a backend connect() may block for seconds (bounded by the
	  per-backend connect timeout), a preemptible priority avoids starving
	  higher-priority work.

comment "Shell"

config CONNECTIVITY_SHELL
	bool "Enable connectivity shell commands (conn up / conn status)"
	default n
	depends on CONNECTIVITY_MODULE && SHELL
	help
	  Registers `conn up` to manually trigger a priority-ordered connect
	  attempt (connectivity_module_connect_auto()) and `conn status` to print
	  the current connectivity state, link type and error code. Useful as a
	  manual fallback alongside the automatic boot-time / provisioning-triggered
	  connect attempts.

endif # CONNECTIVITY_MODULE
```

## src/modules/event_benchmark/Kconfig
```kconfig
# Event system benchmark module (shell root command: bench)
menuconfig EVENT_BENCHMARK
	bool "Enable event system benchmark module"
	default n
	depends on EVENT_SYSTEM
	depends on EVENT_MAX_TYPES > 80
	help
	  Optional performance benchmark for the event system: publish->deliver
	  dispatch latency and per-tier slab create->free round trip statistics
	  (samples / min / p50 / p95 / max / mean in ns). Programmatic API in
	  include/zeplod/event_benchmark.h plus a `bench` shell root command
	  (dispatch / slab / all). Uses the dedicated event type ID 80, hence
	  EVENT_MAX_TYPES must exceed 80.
	  Memory cost: one preallocated sample buffer of
	  EVENT_BENCHMARK_MAX_SAMPLES * 8 bytes of static RAM.
	  Note: native_sim timing reflects host simulation; real baselines must
	  be measured on target hardware.

if EVENT_BENCHMARK

config EVENT_BENCHMARK_SHELL
	bool "Register bench shell commands"
	default y
	depends on SHELL
	help
	  Register the `bench` shell root command (dispatch / slab / all).
	  The programmatic API works without this option.

config EVENT_BENCHMARK_MAX_SAMPLES
	int "Preallocated benchmark sample buffer size"
	default 5000
	range 64 16384
	help
	  Number of preallocated samples (8 bytes each, static RAM) shared by
	  the dispatch and slab benchmarks. Iteration counts above this value
	  are rejected with EVENT_ERR_INVALID_ARG. The shell defaults
	  (dispatch 1000, slab 5000) require at least 5000.

config EVENT_BENCHMARK_DELIVERY_TIMEOUT_MS
	int "Per-event dispatch delivery timeout (ms)"
	default 1000
	range 10 10000
	help
	  Wait limit per iteration for the subscription callback to deliver a
	  published benchmark event. On timeout the run aborts early so a broken
	  dispatcher cannot stall the shell for iterations * timeout.

endif
```

## src/modules/ota/Kconfig
```kconfig
menuconfig OTA_MODULE
	bool "Enable OTA module"
	default n
	depends on EVENT_MAX_TYPES > 51
	help
	  Firmware OTA state machine with pluggable ingest paths.
	  Requires CONFIG_EVENT_MAX_TYPES > 51 (event IDs 50-51).

if OTA_MODULE

config OTA_MODULE_AUTOINIT
	bool "Auto-register OTA module at boot (SYS_INIT)"
	default y
	help
	  Register ota_module via module_manager at APP_INIT_PRIO_MODULE_OTA.
	  Disable for unit tests that call ota_module_init() manually.

config OTA_TRANSPORT_NULL
	bool "Null (RAM) transport for ztest / native_sim only"
	default n
	help
	  Exclusive test mode using in-RAM simulated image. Disables product
	  ingest options below.

if !OTA_TRANSPORT_NULL

config OTA_TRANSPORT_MCUMGR_SMP
	bool "MCUmgr SMP passive ingest (primary product path)"
	default y
	depends on MCUMGR && IMG_MANAGER
	help
	  External mcumgr client pushes firmware via Zephyr img_mgmt.
	  Enable one or more MCUMGR_TRANSPORT_* (UART, BLE, UDP) in conf.
	  See conf/targets/mcumgr_smp.conf.

config OTA_TRANSPORT_ACTIVE
	bool "Active write_chunk ingest (custom protocol extension)"
	default n
	depends on IMG_MANAGER
	help
	  Enables ota_module_begin_update/write_chunk/finish using MCUboot
	  flash_img backend. For Modbus, HTTP, or other self-built transports.
	  May be combined with OTA_TRANSPORT_MCUMGR_SMP; only one ingest
	  session may run at a time (enforced at runtime).

endif

config OTA_NULL_TRANSPORT_BUF_SIZE
	int "Null transport simulated image size (bytes)"
	default 4096
	depends on OTA_TRANSPORT_NULL
	help
	  Size of in-RAM image buffer for native_sim tests.

config OTA_EXPECTED_IMAGE_SIZE
	int "Expected max OTA image size (progress denominator)"
	default 4096 if OTA_TRANSPORT_NULL
	default 524288 if OTA_TRANSPORT_ACTIVE
	default 524288 if OTA_TRANSPORT_MCUMGR_SMP
	help
	  Used to compute download percent when transport has no fixed capacity.

endif
```

## src/modules/provisioning/Kconfig
```kconfig
menuconfig PROVISIONING_MODULE
	bool "Enable provisioning module"
	default n
	depends on EVENT_MAX_TYPES > 61
	help
	  Device identity and provisioning state machine.
	  Requires CONFIG_EVENT_MAX_TYPES > 61 (event ID 61).

if PROVISIONING_MODULE

config PROVISIONING_MODULE_AUTOINIT
	bool "Auto-register provisioning module at boot"
	default y

config PROVISIONING_DEVICE_ID
	string "Device ID string (UUID or serial)"
	default "zeplod-dev-00000001"
	help
	  Exposed via provisioning_module_get_device_id(). Override per SKU in production.

config PROVISIONING_SHELL
	bool "Enable provisioning shell commands (prov set-wifi / prov show)"
	default n
	depends on SHELL
	help
	  Registers `prov set-wifi <ssid> <psk>` to inject Wi-Fi credentials
	  (persisted via app_kv) and `prov show` to display provisioning state
	  and the saved SSID (PSK is never echoed back).

endif
```

## tests/testcase.yaml
```yaml
tests:
  zeplod.tests:
    type: unit
    tags:
      - zeplod
      - unit
      - ztest
      - core
      - ipc
      - data_bus
      - slow
    harness: ztest
    platform_allow:
      - native_sim
      - native_posix
```
